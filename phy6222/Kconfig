## phy6222/bbb_sdk/Kconfig
```kconfig
config PHY6222_SDK
  bool "phyplus phy6222 ble sdk"
  default n
  help
    enable phyplus phy6222 ble sdk.
config PHY6222_PHY_MESH
  depends on PHY6222_SDK
  bool "phyplus phy6222 ble mesh components"
  default n
  help
    enable phyplus phy6222 ble mesh components.
```

## phy6222/config/Kconfig
```kconfig
menu "Phyplus bluetooth applications"
	depends on PHY6222_SDK

	source "$APPSDIR/phy6222/config/simpleBlePeripheral/Kconfig"
	source "$APPSDIR/phy6222/config/sbpAdvScan/Kconfig"
	source "$APPSDIR/phy6222/config/mesh_light/Kconfig"
	source "$APPSDIR/phy6222/config/mijia_mesh_light/Kconfig"
	source "$APPSDIR/phy6222/config/mijia_advscan/Kconfig"
endmenu # Phyplus bluetooth application
```

## phy6222/config/mesh_light/Kconfig
```kconfig
#
# For a description of the syntax of this configuration file,
# see the file kconfig-language.txt in the NuttX tools repository.
#

config PHYAPP_MSH_LIGHT
  depends on PHY6222_PHY_MESH
	tristate "\"Phy6222 BLE mesh light app !\" example"
	default n
	---help---
		Enable the \"Phy6222 BLE mesh light app !\" example

if PHYAPP_MSH_LIGHT

config PHYAPP_MSH_LIGHT_PROGNAME
	string "Program name"
	default "light"
	---help---
		This is the name of the program that will be used when the NSH ELF
		program is installed.

config PHYAPP_MSH_LIGHT_PRIORITY
	int "Phy6222 BLE app mesh light task priority"
	default 100

config PHYAPP_MSH_LIGHT_STACKSIZE
	int "Phy6222 BLE app mesh light stack size"
	default DEFAULT_TASK_STACKSIZE

endif
```

## phy6222/config/mijia_advscan/Kconfig
```kconfig
#
# For a description of the syntax of this configuration file,
# see the file kconfig-language.txt in the NuttX tools repository.
#

config PHYAPP_MIJIA_ADVSCAN
  depends on PHY6222_PHY_MESH && MIJIA_APIS
	tristate "\"Phy6222 mijia advscan app !\" example"
	default n
	---help---
		Enable the \"Phy6222 mijia advscan app !\" example

if PHYAPP_MIJIA_ADVSCAN

config PHYAPP_MIJIA_ADVSCAN_PROGNAME
	string "Program name"
	default "advscan"
	---help---
		This is the name of the program that will be used when the mijia ELF
		program is installed.

config PHYAPP_MIJIA_ADVSCAN_PRIORITY
	int "Phy6222 mijia mesh advscan task priority"
	default 100

config PHYAPP_MIJIA_ADVSCAN_STACKSIZE
	int "Phy6222 mijia mesh advscan stack size"
	default DEFAULT_TASK_STACKSIZE

endif
```

## phy6222/config/mijia_mesh_light/Kconfig
```kconfig
#
# For a description of the syntax of this configuration file,
# see the file kconfig-language.txt in the NuttX tools repository.
#

config PHYAPP_MIJIA_LIGHT
  depends on PHY6222_PHY_MESH && MIJIA_APIS
	tristate "\"Phy6222 mijia light app !\" example"
	default n
	---help---
		Enable the \"Phy6222 mijia light app !\" example

if PHYAPP_MIJIA_LIGHT

config PHYAPP_MIJIA_LIGHT_PROGNAME
	string "Program name"
	default "light"
	---help---
		This is the name of the program that will be used when the mijia ELF
		program is installed.

config PHYAPP_MIJIA_LIGHT_PRIORITY
	int "Phy6222 mijia mesh light task priority"
	default 100

config PHYAPP_MIJIA_LIGHT_STACKSIZE
	int "Phy6222 mijia mesh light stack size"
	default DEFAULT_TASK_STACKSIZE

endif
```

## phy6222/config/sbpAdvScan/Kconfig
```kconfig
#
# For a description of the syntax of this configuration file,
# see the file kconfig-language.txt in the NuttX tools repository.
#

config PHYAPP_SBPADVSCAN
	tristate "\"Phy6222 BLE sbpAdvScan app !\" example"
	default n
	---help---
		Enable the \"Phy6222 BLE sbpAdvScan app !\" example

if PHYAPP_SBPADVSCAN

config PHYAPP_SBPADVSCAN_PROGNAME
	string "Program name"
	default "advscan"
	---help---
		This is the name of the program that will be used when the NSH ELF
		program is installed.

config PHYAPP_SBPADVSCAN_PRIORITY
	int "Phy6222 BLE app sbpAdvScan task priority"
	default 100

config PHYAPP_SBPADVSCAN_STACKSIZE
	int "Phy6222 BLE app sbpAdvScan stack size"
	default DEFAULT_TASK_STACKSIZE

endif
```

## phy6222/config/simpleBlePeripheral/Kconfig
```kconfig
#
# For a description of the syntax of this configuration file,
# see the file kconfig-language.txt in the NuttX tools repository.
#

config PHYAPP_SIMPLEBLEPERIPHERAL
	tristate "\"Phy6222 BLE app simpleBLEPerpheral!\" example"
	default n
	---help---
		Enable the \"Phy6222 BLE app simpleBLEPerpheral!\" example

if PHYAPP_SIMPLEBLEPERIPHERAL

config PHYAPP_SIMPLEBLEPERIPHERAL_PROGNAME
	string "Program name"
	default "sbp"
	---help---
		This is the name of the program that will be used when the NSH ELF
		program is installed.

config PHYAPP_SIMPLEBLEPERIPHERAL_PRIORITY
	int "Phy6222 BLE app simpleBLEPerpheral task priority"
	default 100

config PHYAPP_SIMPLEBLEPERIPHERAL_STACKSIZE
	int "Phy6222 BLE app simpleBLEPerpheral stack size"
	default DEFAULT_TASK_STACKSIZE

endif
```
